## conf/layer.conf
```bitbake
# We have a conf and classes directory, add to BBPATH
BBPATH .= ":${LAYERDIR}"

# We have recipes-* directories, add to BBFILES
BBFILES += "${LAYERDIR}/recipes-*/*/*.bb \
            ${LAYERDIR}/recipes-*/*/*.bbappend"

BBFILE_COLLECTIONS += "meta-tweaks"
BBFILE_PATTERN_meta-tweaks = "^${LAYERDIR}/"
BBFILE_PRIORITY_meta-tweaks = "6"

LAYERDEPENDS_meta-tweaks = "core"
LAYERSERIES_COMPAT_meta-tweaks = "warrior zeus"
```
